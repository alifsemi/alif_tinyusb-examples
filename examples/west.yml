## examples/west.yml
```yaml
manifest:
  
  defaults:
    remote: alif

  remotes:
    - name: alif
      url-base: https://github.com/alifsemi
  
  projects:
    - name: zephyr
      repo-path: zephyr_alif.git
      revision: main
      import: true
  self:
    path: .
```
